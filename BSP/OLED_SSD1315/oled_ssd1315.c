#include "oled_ssd1315.h"
#include "iic.h"
#include <string.h>
#include <stdio.h>
#include "cmsis_os.h"
 
/* ==================== 显存缓冲区 ==================== */
static uint8_t OLED_GRAM[SSD1315_PAGES][SSD1315_WIDTH];

/* 脏页标记: bit N = 第 N 页自上次刷新后被改动过。
 * 软件 IIC 推一整帧 (8 页 x 128B) 约 150ms, 全屏刷新最高只有 6~7Hz;
 * 有脏页标记后 OLED_Update() 只推真正变化的页 (实测约 19ms/页)。 */
static uint8_t OLED_DirtyMask = 0x00;

static inline void OLED_MarkDirty(uint8_t page)
{
    OLED_DirtyMask |= (uint8_t)(1u << page);
}
 
/* ==================== 底层I2C操作 ==================== */
/* 注意: SSD1315_I2C_ADDR = 0x78 (8位写地址, 已含R/W位=0).
 *        iic_send_byte 直接发送字节, 不做左移, 因此仍传 0x78.
 *        若改用 iic_master_write API, 需传 7 位地址 0x3C. */
 
/**
 * @brief  向SSD1315写入一个命令
 * @param  cmd: 命令字节
 * @retval 0=成功, 非0=失败
 */
static uint8_t OLED_WriteCmd(uint8_t cmd)
{
    iic_status_t ret;
    iic_start(IIC_BUS_OLED);
    ret = iic_send_byte(IIC_BUS_OLED, SSD1315_I2C_ADDR);  /* 设备地址 + 写 */
    if (ret != IIC_OK) { iic_stop(IIC_BUS_OLED); return 1; }
    ret = iic_send_byte(IIC_BUS_OLED, 0x00);              /* 控制字节: Co=0, D/C#=0 (命令) */
    if (ret != IIC_OK) { iic_stop(IIC_BUS_OLED); return 2; }
    ret = iic_send_byte(IIC_BUS_OLED, cmd);               /* 命令字节 */
    if (ret != IIC_OK) { iic_stop(IIC_BUS_OLED); return 3; }
    iic_stop(IIC_BUS_OLED);
    return 0;
}
 
/* 说明: 模板原有的 OLED_WriteData() (单字节写) 已在工程副本中删除 ——
 * 它没有任何调用者, 功能完全被 OLED_WriteDataBurst() 覆盖,
 * 保留只会产生 AC5 的 #177-D "declared but never referenced" 警告。
 * 需要写单字节时用 OLED_WriteDataBurst(&b, 1) 即可。 */
 
/**
 * @brief  向SSD1315连续写入多个数据字节
 * @param  pdata: 数据缓冲区指针
 * @param  len: 数据长度
 * @retval 0=成功, 非0=失败
 */
static uint8_t OLED_WriteDataBurst(const uint8_t *pdata, uint16_t len)
{
    iic_status_t ret;
    iic_start(IIC_BUS_OLED);
    ret = iic_send_byte(IIC_BUS_OLED, SSD1315_I2C_ADDR);
    if (ret != IIC_OK) { iic_stop(IIC_BUS_OLED); return 1; }
    ret = iic_send_byte(IIC_BUS_OLED, 0x40);              /* 控制字节: 数据模式 */
    if (ret != IIC_OK) { iic_stop(IIC_BUS_OLED); return 2; }
    for (uint16_t i = 0; i < len; i++)
    {
        ret = iic_send_byte(IIC_BUS_OLED, pdata[i]);
        if (ret != IIC_OK) { iic_stop(IIC_BUS_OLED); return 3; }
    }
    iic_stop(IIC_BUS_OLED);
    return 0;
}
 
/* ==================== 6x8 ASCII 字库 ==================== */
static const uint8_t F6x8[][6] =
{
    {0x00,0x00,0x00,0x00,0x00,0x00},   // sp
    {0x00,0x00,0x00,0x2f,0x00,0x00},   // !
    {0x00,0x00,0x07,0x00,0x07,0x00},   // "
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    {0x00,0x08,0x1C,0x2A,0x08,0x08},   // <-
};
 
/* ==================== 8x16 ASCII 字库 ==================== */
static const uint8_t F8X16[] =
{
    0x00,0x00,0x00,0x00,0x00,0x00,0x00,0x00,0x00,0x00,0x00,0x00,0x00,0x00,0x00,0x00,// 0
    0x00,0x00,0x00,0xF8,0x00,0x00,0x00,0x00,0x00,0x00,0x00,0x33,0x30,0x00,0x00,0x00,// !
    0x00,0x10,0x0C,0x06,0x10,0x0C,0x06,0x00,0x00,0x00,0x00,0x00,0x00,0x00,0x00,0x00,// "
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    0x00,0x06,0x01,0x01,0x02,0x02,0x04,0x04,0x00,0x00,0x00,0x00,0x00,0x00,0x00,0x00,// ~
};
 
/* ==================== 初始化与控制 ==================== */
 
/**
 * @brief  SSD1315 OLED 初始化
 * @retval 0=成功, 非0=失败
 */
uint8_t OLED_Init(void)
{
    uint8_t ret;
 
    osDelay(100);  /* 上电等待 */
 
    /* 初始化命令序列 */
    ret  = OLED_WriteCmd(SSD1315_CMD_DISPLAY_OFF);          /* 关闭显示 */
    ret |= OLED_WriteCmd(SSD1315_CMD_SET_CLOCK_DIV);        /* 设置时钟分频 */
    ret |= OLED_WriteCmd(0x80);                             /* 分频因子=1, 振荡器频率=中间值 */
    ret |= OLED_WriteCmd(SSD1315_CMD_SET_MULTIPLEX);        /* 设置多路复用比 */
    ret |= OLED_WriteCmd(SSD1315_HEIGHT - 1);               /* 64行: 0x3F */
    ret |= OLED_WriteCmd(SSD1315_CMD_SET_DISPLAY_OFFSET);   /* 设置显示偏移 */
    ret |= OLED_WriteCmd(0x00);                             /* 偏移=0 */
    ret |= OLED_WriteCmd(SSD1315_CMD_SET_START_LINE | 0x00);/* 设置起始行=0 */
    ret |= OLED_WriteCmd(SSD1315_CMD_CHARGE_PUMP);          /* 电荷泵设置 */
    ret |= OLED_WriteCmd(SSD1315_CHARGE_PUMP_ENABLE);       /* 开启电荷泵 */
    ret |= OLED_WriteCmd(SSD1315_CMD_SET_MEM_ADDR_MODE);    /* 设置内存地址模式 */
    ret |= OLED_WriteCmd(SSD1315_ADDR_MODE_HORIZONTAL);     /* 水平地址模式 */
    ret |= OLED_WriteCmd(SSD1315_CMD_SEGMENT_REMAP_127);    /* 段重映射: 列127->SEG0 (水平翻转) */
    ret |= OLED_WriteCmd(SSD1315_CMD_COM_SCAN_REMAP);       /* COM扫描方向: 从下到上 (垂直翻转) */
    ret |= OLED_WriteCmd(SSD1315_CMD_SET_COM_PINS);         /* 设置COM引脚配置 */
    ret |= OLED_WriteCmd(0x12);                             /* 0x12: 128x64 配置 */
    ret |= OLED_WriteCmd(SSD1315_CMD_SET_CONTRAST);         /* 设置对比度 */
    ret |= OLED_WriteCmd(0xCF);                             /* 对比度值 */
    ret |= OLED_WriteCmd(SSD1315_CMD_SET_PRECHARGE);        /* 设置预充电周期 */
    ret |= OLED_WriteCmd(0xF1);                             /* 预充电: Phase1=1, Phase2=F */
    ret |= OLED_WriteCmd(SSD1315_CMD_SET_VCOMH);            /* 设置VCOMH电压 */
    ret |= OLED_WriteCmd(0x30);                             /* VCOMH = 0.83*VCC */
    ret |= OLED_WriteCmd(SSD1315_CMD_ENTIRE_DISPLAY_OFF);   /* 全局显示关闭 (跟随RAM) */
    ret |= OLED_WriteCmd(SSD1315_CMD_NORMAL_DISPLAY);       /* 正常显示模式 */
    ret |= OLED_WriteCmd(SSD1315_CMD_DISPLAY_ON);           /* 开启显示 */
 
    if (ret != 0)
        return 1;
 
    /* 只清显存 (RAM), 不推屏 —— 这里以前是 OLED_Clear():
     * 它清完 RAM 会立刻把 8 页全推一遍, 软件 IIC 下约 150ms, 而屏幕内容马上
     * 就会被调用方的第一帧覆盖 (oled_task: OledTask_StaticScreen() 后的 OLED_Update()),
     * 等于开机白等 150ms。
     *
     * 清完 DirtyMask = 0xFF, 保证调用方第一次 OLED_Update() 是全屏刷新。
     * "第一帧必须推满 8 页"这条不能省 —— SSD1315 上电时片内 RAM 是随机值,
     * 本函数下发的命令序列只是让它开始跟随 RAM 显示, 并没有清屏能力 ——
     * 只是不该在这里推完、再被同样的内容推第二遍。 */
    OLED_ClearBuffer();
    return 0;
}
 
/**
 * @brief  开启显示
 */
void OLED_DisplayOn(void)
{
    OLED_WriteCmd(SSD1315_CMD_DISPLAY_ON);
}
 
/**
 * @brief  关闭显示
 */
void OLED_DisplayOff(void)
{
    OLED_WriteCmd(SSD1315_CMD_DISPLAY_OFF);
}
 
/**
 * @brief  设置对比度
 * @param  contrast: 对比度值 (0~255)
 */
void OLED_SetContrast(uint8_t contrast)
{
    OLED_WriteCmd(SSD1315_CMD_SET_CONTRAST);
    OLED_WriteCmd(contrast);
}
 
/**
 * @brief  设置显示模式
 * @param  mode: 0=正常, 1=反色
 */
void OLED_SetDisplayMode(uint8_t mode)
{
    if (mode)
        OLED_WriteCmd(SSD1315_CMD_INVERT_DISPLAY);
    else
        OLED_WriteCmd(SSD1315_CMD_NORMAL_DISPLAY);
}
 
/**
 * @brief  清显存 (只清 RAM, 不推屏)
 * @note   渲染流程若是"清屏 -> 画 -> 刷新", 请用本函数而不是 OLED_Clear(),
 *         否则会白推一整帧 (软件 IIC 下约 150ms, 直接吃掉刷新率预算)。
 */
void OLED_ClearBuffer(void)
{
    memset(OLED_GRAM, 0x00, sizeof(OLED_GRAM));
    OLED_DirtyMask = 0xFF;   /* 8 页全部待刷 */
}

/**
 * @brief  清屏 (显存清零并刷新)
 */
void OLED_Clear(void)
{
    OLED_ClearBuffer();
    OLED_Update();
}

/**
 * @brief  全屏填充指定数据
 * @param  data: 填充字节
 */
void OLED_Fill(uint8_t data)
{
    memset(OLED_GRAM, data, sizeof(OLED_GRAM));
    OLED_DirtyMask = 0xFF;
    OLED_Update();
}
 
/* ==================== 显存刷新 ==================== */
 
/**
 * @brief  将显存中"被改动过的页"刷新到 OLED 屏幕
 * @note   只推脏页: 每页单独设列/页窗口, 写完清标记。
 *         软件 IIC 下推一页约 19ms、推满 8 页约 150ms —— 20Hz 刷新
 *         只有在"只推脏页"的前提下才成立。
 */
void OLED_Update(void)
{
    if (OLED_DirtyMask == 0x00)
        return;                       /* 无改动: 一字节 IIC 流量都不产生 */

    for (uint8_t page = 0; page < SSD1315_PAGES; page++)
    {
        if ((OLED_DirtyMask & (uint8_t)(1u << page)) == 0)
            continue;

        /* 该页的列范围: 0 ~ 127 */
        OLED_WriteCmd(SSD1315_CMD_SET_COL_ADDR);
        OLED_WriteCmd(0x00);
        OLED_WriteCmd(SSD1315_WIDTH - 1);

        /* 该页的行窗口: page ~ page (单页, 写满 128 字节自动回到本页列 0) */
        OLED_WriteCmd(SSD1315_CMD_SET_PAGE_ADDR);
        OLED_WriteCmd(page);
        OLED_WriteCmd(page);

        OLED_WriteDataBurst(OLED_GRAM[page], SSD1315_WIDTH);
    }

    OLED_DirtyMask = 0x00;
}
 
/* ==================== 像素操作 ==================== */
 
/**
 * @brief  在显存中设置一个像素
 * @param  x: X坐标 (0~127)
 * @param  y: Y坐标 (0~63)
 * @param  color: 1=点亮, 0=熄灭
 */
void OLED_SetPixel(uint8_t x, uint8_t y, uint8_t color)
{
    if (x >= SSD1315_WIDTH || y >= SSD1315_HEIGHT)
        return;
 
    uint8_t page = y / 8;
    uint8_t bit = y % 8;

    if (color)
    {
        if ((OLED_GRAM[page][x] & (1 << bit)) == 0)
        {
            OLED_GRAM[page][x] |= (1 << bit);
            OLED_MarkDirty(page);        /* 只在像素真的变化时标脏 */
        }
    }
    else
    {
        if ((OLED_GRAM[page][x] & (1 << bit)) != 0)
        {
            OLED_GRAM[page][x] &= ~(1 << bit);
            OLED_MarkDirty(page);
        }
    }
}
 
/**
 * @brief  获取显存中指定像素的状态
 * @param  x: X坐标
 * @param  y: Y坐标
 * @retval 1=点亮, 0=熄灭
 */
uint8_t OLED_GetPixel(uint8_t x, uint8_t y)
{
    if (x >= SSD1315_WIDTH || y >= SSD1315_HEIGHT)
        return 0;
 
    uint8_t page = y / 8;
    uint8_t bit = y % 8;
 
    return (OLED_GRAM[page][x] >> bit) & 0x01;
}
 
/* ==================== 字符与字符串显示 ==================== */
 
/**
 * @brief  在指定位置显示一个字符
 * @param  x: 起始X坐标 (像素)
 * @param  y: 起始Y坐标 (像素)
 * @param  ch: 字符
 * @param  size: 字体大小 (1=6x8, 2=8x16)
 */
void OLED_ShowChar(uint8_t x, uint8_t y, char ch, uint8_t size)
{
    uint8_t c = 0;
    uint8_t i, j;
 
    c = ch - ' ';  /* 字库从空格开始 */
 
    if (size == 1)  /* 6x8 字体 */
    {
        for (i = 0; i < 6; i++)
        {
            uint8_t line = F6x8[c][i];
            for (j = 0; j < 8; j++)
            {
                OLED_SetPixel(x + i, y + j, (line >> j) & 0x01);
            }
        }
    }
    else if (size == 2)  /* 8x16 字体 */
    {
        for (i = 0; i < 8; i++)
        {
            uint8_t line = F8X16[c * 16 + i];
            for (j = 0; j < 8; j++)
            {
                OLED_SetPixel(x + i, y + j, (line >> j) & 0x01);
            }
        }
        for (i = 0; i < 8; i++)
        {
            uint8_t line = F8X16[c * 16 + i + 8];
            for (j = 0; j < 8; j++)
            {
                OLED_SetPixel(x + i, y + 8 + j, (line >> j) & 0x01);
            }
        }
    }
}
 
/**
 * @brief  在指定位置显示字符串
 * @param  x: 起始X坐标
 * @param  y: 起始Y坐标
 * @param  str: 字符串指针
 * @param  size: 字体大小 (1=6x8, 2=8x16)
 */
void OLED_ShowString(uint8_t x, uint8_t y, const char *str, uint8_t size)
{
    uint8_t char_w = (size == 1) ? 6 : 8;
 
    while (*str != '\0')
    {
        if (x + char_w > SSD1315_WIDTH)  /* 换行 */
        {
            x = 0;
            y += (size == 1) ? 8 : 16;
        }
        if (y >= SSD1315_HEIGHT)  /* 超出屏幕 */
            break;
 
        OLED_ShowChar(x, y, *str, size);
        x += char_w;
        str++;
    }
}
 
/**
 * @brief  显示数字
 * @param  x: 起始X坐标
 * @param  y: 起始Y坐标
 * @param  num: 数字
 * @param  len: 显示位数
 * @param  size: 字体大小
 */
void OLED_ShowNum(uint8_t x, uint8_t y, uint32_t num, uint8_t len, uint8_t size)
{
    char buf[12];
    snprintf(buf, sizeof(buf), "%0*lu", len, (unsigned long)num);
    OLED_ShowString(x, y, buf, size);
}
 
/**
 * @brief  显示十六进制数
 * @param  x: 起始X坐标
 * @param  y: 起始Y坐标
 * @param  num: 数字
 * @param  len: 显示位数
 * @param  size: 字体大小
 */
void OLED_ShowHex(uint8_t x, uint8_t y, uint32_t num, uint8_t len, uint8_t size)
{
    char buf[12];
    snprintf(buf, sizeof(buf), "%0*lX", len, (unsigned long)num);
    OLED_ShowString(x, y, buf, size);
}
 
/**
 * @brief  显示浮点数
 * @param  x: 起始X坐标
 * @param  y: 起始Y坐标
 * @param  num: 浮点数
 * @param  int_len: 整数部分位数
 * @param  dec_len: 小数部分位数
 * @param  size: 字体大小
 */
void OLED_ShowFloat(uint8_t x, uint8_t y, float num, uint8_t int_len, uint8_t dec_len, uint8_t size)
{
    char buf[20];
    char fmt[10];
    snprintf(fmt, sizeof(fmt), "%%0%d.%df", int_len + dec_len + 1, dec_len);
    snprintf(buf, sizeof(buf), fmt, num);
    OLED_ShowString(x, y, buf, size);
}
 
/* ==================== 图形绘制 ==================== */
 
/**
 * @brief  画直线 (Bresenham算法)
 */
void OLED_DrawLine(uint8_t x1, uint8_t y1, uint8_t x2, uint8_t y2, uint8_t color)
{
    int16_t dx = (x2 > x1) ? (x2 - x1) : (x1 - x2);
    int16_t dy = (y2 > y1) ? (y2 - y1) : (y1 - y2);
    int16_t sx = (x1 < x2) ? 1 : -1;
    int16_t sy = (y1 < y2) ? 1 : -1;
    int16_t err = dx - dy;
    int16_t x = x1;
    int16_t y = y1;
 
    while (1)
    {
        OLED_SetPixel((uint8_t)x, (uint8_t)y, color);
        if (x == x2 && y == y2) break;
        int16_t e2 = 2 * err;
        if (e2 > -dy) { err -= dy; x += sx; }
        if (e2 < dx)  { err += dx; y += sy; }
    }
}
 
/**
 * @brief  画矩形 (空心)
 */
void OLED_DrawRectangle(uint8_t x1, uint8_t y1, uint8_t x2, uint8_t y2, uint8_t color)
{
    OLED_DrawLine(x1, y1, x2, y1, color);
    OLED_DrawLine(x2, y1, x2, y2, color);
    OLED_DrawLine(x2, y2, x1, y2, color);
    OLED_DrawLine(x1, y2, x1, y1, color);
}
 
/**
 * @brief  画矩形 (实心)
 */
void OLED_DrawFillRectangle(uint8_t x1, uint8_t y1, uint8_t x2, uint8_t y2, uint8_t color)
{
    if (x1 > x2) { uint8_t t = x1; x1 = x2; x2 = t; }
    if (y1 > y2) { uint8_t t = y1; y1 = y2; y2 = t; }
 
    for (uint8_t y = y1; y <= y2; y++)
    {
        for (uint8_t x = x1; x <= x2; x++)
        {
            OLED_SetPixel(x, y, color);
        }
    }
}
 
/**
 * @brief  画圆 (空心, 中点圆算法)
 */
void OLED_DrawCircle(uint8_t x, uint8_t y, uint8_t r, uint8_t color)
{
    int16_t a = 0, b = r;
    int16_t d = 1 - r;
 
    while (a <= b)
    {
        OLED_SetPixel(x + a, y - b, color);
        OLED_SetPixel(x + b, y - a, color);
        OLED_SetPixel(x + b, y + a, color);
        OLED_SetPixel(x + a, y + b, color);
        OLED_SetPixel(x - a, y + b, color);
        OLED_SetPixel(x - b, y + a, color);
        OLED_SetPixel(x - b, y - a, color);
        OLED_SetPixel(x - a, y - b, color);
 
        a++;
        if (d < 0)
            d += 2 * a + 1;
        else
        {
            b--;
            d += 2 * (a - b) + 1;
        }
    }
}
 
/**
 * @brief  画圆 (实心)
 */
void OLED_DrawFillCircle(uint8_t x, uint8_t y, uint8_t r, uint8_t color)
{
    int16_t a = 0, b = r;
    int16_t d = 1 - r;
 
    while (a <= b)
    {
        for (int16_t i = x - a; i <= x + a; i++)
        {
            OLED_SetPixel((uint8_t)i, y + b, color);
            OLED_SetPixel((uint8_t)i, y - b, color);
        }
        for (int16_t i = x - b; i <= x + b; i++)
        {
            OLED_SetPixel((uint8_t)i, y + a, color);
            OLED_SetPixel((uint8_t)i, y - a, color);
        }
 
        a++;
        if (d < 0)
            d += 2 * a + 1;
        else
        {
            b--;
            d += 2 * (a - b) + 1;
        }
    }
}
 
/* ==================== 图片显示 ==================== */
 
/**
 * @brief  显示位图 (纵向扫描, 每字节8像素, 低位在上)
 * @param  x: 起始X坐标
 * @param  y: 起始Y坐标
 * @param  w: 图片宽度
 * @param  h: 图片高度
 * @param  bmp: 位图数据指针
 */
void OLED_DrawBMP(uint8_t x, uint8_t y, uint8_t w, uint8_t h, const uint8_t *bmp)
{
    uint8_t pages = (h + 7) / 8;
 
    for (uint8_t p = 0; p < pages; p++)
    {
        for (uint8_t i = 0; i < w; i++)
        {
            uint8_t byte = bmp[p * w + i];
            for (uint8_t b = 0; b < 8; b++)
            {
                if (y + p * 8 + b < SSD1315_HEIGHT && x + i < SSD1315_WIDTH)
                {
                    OLED_SetPixel(x + i, y + p * 8 + b, (byte >> b) & 0x01);
                }
            }
        }
    }
}
 
/* ==================== 滚动效果 ==================== */
 
/**
 * @brief  水平右滚动
 * @param  start_page: 起始页 (0~7)
 * @param  end_page: 结束页 (0~7)
 * @param  speed: 滚动速度 (0=最快, 7=最慢)
 */
void OLED_ScrollRight(uint8_t start_page, uint8_t end_page, uint8_t speed)
{
    OLED_WriteCmd(SSD1315_CMD_SCROLL_STOP);
    OLED_WriteCmd(SSD1315_CMD_SCROLL_RIGHT);
    OLED_WriteCmd(0x00);
    OLED_WriteCmd(start_page & 0x07);
    OLED_WriteCmd(speed & 0x07);
    OLED_WriteCmd(end_page & 0x07);
    OLED_WriteCmd(0x00);
    OLED_WriteCmd(0xFF);
    OLED_WriteCmd(SSD1315_CMD_SCROLL_START);
}
 
/**
 * @brief  水平左滚动
 * @param  start_page: 起始页
 * @param  end_page: 结束页
 * @param  speed: 滚动速度
 */
void OLED_ScrollLeft(uint8_t start_page, uint8_t end_page, uint8_t speed)
{
    OLED_WriteCmd(SSD1315_CMD_SCROLL_STOP);
    OLED_WriteCmd(SSD1315_CMD_SCROLL_LEFT);
    OLED_WriteCmd(0x00);
    OLED_WriteCmd(start_page & 0x07);
    OLED_WriteCmd(speed & 0x07);
    OLED_WriteCmd(end_page & 0x07);
    OLED_WriteCmd(0x00);
    OLED_WriteCmd(0xFF);
    OLED_WriteCmd(SSD1315_CMD_SCROLL_START);
}
 
/**
 * @brief  停止滚动
 */
void OLED_ScrollStop(void)
{
    OLED_WriteCmd(SSD1315_CMD_SCROLL_STOP);
}
 
/* ==================== 光标定位 ==================== */
 
/**
 * @brief  设置字符光标位置 (基于8x16字符网格)
 * @param  row: 行号 (0~3, 因为64/16=4行)
 * @param  col: 列号 (0~15, 因为128/8=16列)
 */
void OLED_SetCursor(uint8_t row, uint8_t col)
{
    /* 此函数用于记录光标位置, 配合OLED_ShowString使用 */
    /* 实际显示时需要调用OLED_ShowString(row*16, col*8, ...) */
    /* 这里提供一个便捷的行/列到像素的转换参考 */
}

